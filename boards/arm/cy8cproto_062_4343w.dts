/*
 * Copyright (c) 2021 Cypress Semiconductor Corporation.
 * SPDX-License-Identifier: Apache-2.0
 *  #include <cypress/psoc6_cm4.dtsi> #include <infineon/psoc6/cy8c624abzi_s2d44.dtsi>
 */

/dts-v1/;
#include "gpio_pin_def.h"
#include <infineon/psoc6/mpns/CY8C624ABZI_S2D44.dtsi>
#include "cy8cproto_062_4343w_common.dtsi"

/ {
	model = "cy8cproto_062_4343w with an Cypress PSoC™ 6 SoC";
	compatible = "cy8cproto_062_4343w", "PSoC6";

	aliases {
		uart-5 = &uart5;
	};

	chosen {
		zephyr,sram = &sram0;
		zephyr,flash = &flash0;
		zephyr,console = &uart5;
		zephyr,shell-uart = &uart5;
	};
};

&uart5 {
	status = "okay";
	current-speed = <115200>;
	rx-pin = <P5_0>;
	tx-pin = <P5_1>;
};
