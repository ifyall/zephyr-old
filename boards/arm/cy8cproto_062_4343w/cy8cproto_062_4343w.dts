/*
 * Copyright (c) 2021 Cypress Semiconductor Corporation.
 * SPDX-License-Identifier: Apache-2.0
 */

/dts-v1/;

#include <cypress/psoc6_cm4.dtsi>
#include "cy8cproto_062_4343w_common.dtsi"
/ {
	model = "cy8cproto_062_4343w with an Cypress PSoC™ 6 SoC";
	compatible = "cy8cproto_062_4343w", "PSoC6";

	aliases {
		uart-5 = &uart5;
	};

	chosen {
		zephyr,sram = &sram2;
		zephyr,flash = &flash1;
		zephyr,console = &uart5;
		zephyr,shell-uart = &uart5;
	};
};

&uart5 {
	status = "okay";
	current-speed = <115200>;

	pinctrl-0 = <&p5_0_uart5_rx &p5_1_uart5_tx>;
};
