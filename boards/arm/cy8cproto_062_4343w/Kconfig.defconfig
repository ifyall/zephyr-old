## boards/arm/cy8cproto_062_4343w/Kconfig.defconfig
```kconfig
# CY8CPROTO-062-4343W PSoC™ 6 Wi-Fi BT Prototyping Kit configuration

# Copyright (c) 2020 ATL Electronics
# SPDX-License-Identifier: Apache-2.0

if BOARD_CY8CPROTO_062_4343W

config BOARD
	default "cy8cproto_062_4343w" 

endif   # BOARD_CY8CPROTO_062_4343W
```

## boards/arm/cy8cproto_062_4343w/cy8cproto_062_4343w_defconfig
```kconfig
#
# Copyright (c) 2021 Cypress Semiconductor Corporation.
# SPDX-License-Identifier: Apache-2.0
#

CONFIG_SOC_SERIES_PSOC62=y
CONFIG_SOC_CY8C624ABZI_S2D44=y



#CONFIG_LIB_CPLUSPLUS=y
#CONFIG_NEWLIB_LIBC=y

#CONFIG_SOC_CY8C624ABZI_S2D44A0=y

CONFIG_CORTEX_M_SYSTICK=y
#CONFIG_CONSOLE=y
#CONFIG_UART_CONSOLE=y
CONFIG_BUILD_OUTPUT_HEX=y

# UART driver
#CONFIG_SERIAL=y
```

## drivers/bluetooth/hci/vendor/infineon/Kconfig
```kconfig
# Copyright (c) 2022 Cypress Semiconductor Corporation.
# SPDX-License-Identifier: Apache-2.0

# Change size of command lengths. It for vendor commands related to
# firmware downloading.
config BT_BUF_CMD_TX_SIZE
	default 255

choice  CYW43XXX_PART
	prompt "Select CYW43XXX part"
	depends on BT_CYW43XXX

config CYW4343W
	bool "CYW4343W"
	help
	  Enable Infineon CYW4343W BLE connectivity,
	  More information about CYW4343W device you can find on
	  https://www.infineon.com/cms/en/product/wireless-connectivity/airoc-wi-fi-plus-bluetooth-combos/cyw4343w/

config CYW4373
	bool "CYW4373"
	help
	  Enable Infineon CYW4373 BLE connectivity,
	  More information about CYW4373 device you can find on
	  https://www.infineon.com/cms/en/product/wireless-connectivity/airoc-wi-fi-plus-bluetooth-combos/cyw4373/

config CYW43012
	bool "CYW43012"
	help
	  Enable Infineon CYW43012 BLE connectivity,
	  More information about CYW43012 device you can find on
	  https://www.infineon.com/cms/en/product/wireless-connectivity/airoc-wi-fi-plus-bluetooth-combos/cyw43012/

config CYW43438
	bool "CYW43438"
	help
	  Enable Infineon CYW43438 BLE connectivity,
	  More information about CYW43438 device you can find on
	  https://www.infineon.com/cms/en/product/wireless-connectivity/airoc-wi-fi-plus-bluetooth-combos/cyw43438/

config CYW43439
	bool "CYW43439"
	help
	  Enable Infineon CYW43439 BLE connectivity,
	  More information about CYW43439 device you can find on
	  https://www.infineon.com/cms/en/product/wireless-connectivity/airoc-wi-fi-plus-bluetooth-combos/cyw43439/


choice CYW43012_MODULE
	prompt "Select CYW43012 module"
	depends on CYW43012
	depends on BT_CYW43XXX

config CYW43012_MURATA_1LV
	bool "MURATA-1LV"

config CYW43012_CYSBSYS_RP01
	bool "CYSBSYS-RP01"

config CYW43012_WM_BAC_CYW_50
	bool "WM-BAC-CYW-50"

config CYW43012_CUSTOM
	bool "Custom CYW43012 module"
endchoice


choice CYW4343W_MODULE
	prompt "Select CYW4343W module"
	depends on CYW4343W
	depends on BT_CYW43XXX


config CYW4343W_MURATA_1DX
	bool "MURATA-1DX"

config CYW4343W_CUSTOM
	bool "Custom CYW4343W module"

endchoice


choice CYW4373_MODULE
	prompt "Select CYW4373 module"
	depends on CYW4373
	depends on BT_CYW43XXX

config CYW4373_STERLING_LWB5PLUS
	bool "STERLING-LWB5plus"

config CYW4373_CUSTOM
	bool "Custom CYW4373 module"

endchoice


choice CYW43438_MODULE
	prompt "Select CYW43438 module"
	depends on CYW43438
	depends on BT_CYW43XXX

config CYW43438_AW_CU427_P
	bool "AW-CU427-P"

config CYW43438_CUSTOM
	bool "Custom CYW43438 module"

endchoice


choice CYW43439_MODULE
	prompt "Select CYW43439 module"
	depends on CYW43439
	depends on BT_CYW43XXX

config CYW43439_MURATA_1YN
	bool "MURATA_1YN"

config CYW43439_CYW943439M2IPA
	bool "CYW943439M2IPA1"

config CYW43439_CUSTOM
	bool "Custom CYW43439 module"

endchoice
endchoice
```

## drivers/counter/Kconfig.ifx_cat1
```kconfig
# Copyright (c) 2021 Cypress Semiconductor Corporation.
# SPDX-License-Identifier: Apache-2.0

DT_COMPAT_INFINEON_CAT1_COUNTER := infineon,mtbhal-counter

config COUNTER_INFINEON_CAT1
	bool "Infineon CAT1 COUNTER driver"
		default $(dt_compat_enabled,$(DT_COMPAT_INFINEON_CAT1_COUNTER))
	depends on SOC_FAMILY_INFINEON_CAT1
	select USE_INFINEON_TIMER
	help
	  This option enables the COUNTER driver for Infineon CAT1 family.
```

## drivers/gpio/Kconfig.ifx_cat1
```kconfig
# Infineon CAT1 GPIO configuration options

# Copyright (c) 2022 Cypress Semiconductor Corporation.
# SPDX-License-Identifier: Apache-2.0

DT_COMPAT_INFINEON_CAT1_GPIO := infineon,mtbhal-gpio

config GPIO_INFINEON_CAT1
	bool "Infineon CAT1 GPIO driver"
		default $(dt_compat_enabled,$(DT_COMPAT_INFINEON_CAT1_GPIO))
	depends on SOC_FAMILY_INFINEON_CAT1
	help
		Enable support for Infineon CAT1 GPIO controllers.
```

## drivers/gpio/Kconfig.infineon_cat1
```kconfig
# Copyright (c) 2021 Cypress Semiconductor Corporation.
# SPDX-License-Identifier: Apache-2.0


config GPIO_CAT1
    bool "Infineon CAT1 GPIO driver"
        default y
    depends on SOC_FAMILY_CAT1
    help
     Enable support for Infineon CAT1 GPIO controllers.
```

## drivers/i2c/Kconfig.infineon_cat1
```kconfig
# Infineon CAT1 I2C configuration options

# Copyright (c) 2022 Cypress Semiconductor Corporation.
# SPDX-License-Identifier: Apache-2.0

DT_COMPAT_INFINEON_CAT1_I2C := infineon,mtbhal-i2c

config I2C_INFINEON_CAT1
	bool "Infineon CAT1 I2C driver"
		default $(dt_compat_enabled,$(DT_COMPAT_INFINEON_CAT1_I2C))
	depends on SOC_FAMILY_CAT1
	select USE_INFINEON_I2C
	help
	  This option enables the I2C driver for Infineon CAT1 family.
```

## drivers/pinctrl/Kconfig.ifx_cat1
```kconfig
# Infineon CAT1 Pin controller configuration options

# Copyright (c) 2022 Cypress Semiconductor Corporation.
# SPDX-License-Identifier: Apache-2.0

DT_COMPAT_INFINEON_CAT1_PINCTRL := infineon,mtbhal-pinctrl

config PINCTRL_INFINEON_CAT1
	bool "Pin controller driver for Infineon CAT1 MCUs"
	depends on SOC_FAMILY_INFINEON_CAT1
		default $(dt_compat_enabled,$(DT_COMPAT_INFINEON_CAT1_PINCTRL))
	help
	  Enable Pin controller driver for Infineon CAT1 MCUs
```

## drivers/serial/Kconfig.infineon_cat1
```kconfig
# Infineon CAT1 UART configuration options

# Copyright (c) 2022 Cypress Semiconductor Corporation.
# SPDX-License-Identifier: Apache-2.0

DT_COMPAT_INFINEON_CAT1_UART := infineon,mtbhal-uart

config UART_INFINEON_CAT1
	bool "Infineon CAT1 UART driver"
		default $(dt_compat_enabled,$(DT_COMPAT_INFINEON_CAT1_UART))
	depends on SOC_FAMILY_CAT1
	select SERIAL_HAS_DRIVER
	select SERIAL_SUPPORT_INTERRUPT
	help
	  This option enables the UART driver for Infineon CAT1 family.
```

## drivers/wifi/infineon/Kconfig.infineon_wifi
```kconfig
# Copyright (c) 2022 Cypress Semiconductor Corporation.
# SPDX-License-Identifier: Apache-2.0

source "drivers/wifi/infineon/Kconfig.cyw43xxx"
```

## drivers/wifi/infineon_wifi/Kconfig.infineon_wifi
```kconfig
# Copyright (c) 2022 Cypress Semiconductor Corporation.
# SPDX-License-Identifier: Apache-2.0

source "drivers/wifi/infineon_wifi/Kconfig.cyw43xxx"
```

## dts/bindings/bluetooth/infineon,cyw43xxx-bt-hci.yaml
```yaml
# Copyright (c) 2021, Cypress
# SPDX-License-Identifier: Apache-2.0

description: |
    CYW43xxx Connectivity that uses Zephyr's Bluetooth Host Controller Interface UART
    driver.

compatible: "infineon,cyw43xxx-bt-hci"

include: base.yaml

properties:
    bt-reg-on-gpios:
      type: phandle-array
      required: false

    bt-host-wake-gpios:
      type: phandle-array
      required: false

    bt-dev-wake-gpios:
      type: phandle-array
      required: false

    baudrate_for_fw_download:
       type: int
       default: 3000000
```

## dts/bindings/gpio/infineon,mtbhal-gpio.yaml
```yaml
# Copyright (c) 2020-2021 ATL Electronics
# SPDX-License-Identifier: Apache-2.0

description: Infineon CAT1 GPIO PORT node

compatible: "infineon,mtbhal-gpio"

include: ["gpio-controller.yaml", "base.yaml"]

properties:
    reg:
      required: true

    interrupts:
      required: true

    label:
      required: true

    "#gpio-cells":
      const: 2

gpio-cells:
  - pin
  - flags
```

## dts/bindings/pinctrl/infineon,mtbhal-pinctrl.yaml
```yaml
# Copyright (c) 2022 Cypress Semiconductor Corporation.
# SPDX-License-Identifier: Apache-2.0

description: |
  Infineon CAT1 Pinctrl container node

  The Infineon CAT1 Pinctrl implements following pin configuration option:

    * bias-pull-up
    * bias-pull-down
    * drive-open-drain
    * drive-open-source
    * drive-push-pull   (strong)
    * input-enable      (input-buffer)

compatible: "infineon,mtbhal-pinctrl"

include: [base.yaml, pincfg-node.yaml]

child-binding:
    description: |
        This binding gives a base representation of the Infineon CAT1 pins configuration

    properties:
      pinmux:
        required: true
        type: int

      slew-rate:
        required: false
```

## dts/bindings/serial/infineon,mtbhal-uart.yaml
```yaml
# Copyright (c) 2022, Cypress
# SPDX-License-Identifier: Apache-2.0

description: Infineon CAT1 UART

compatible: "infineon,mtbhal-uart"

include: [uart-controller.yaml, pinctrl-device.yaml]

properties:
    reg:
      required: true

    interrupts:
      required: true

    peripheral-id:
      type: int
      description: peripheral ID
      required: true

    pinctrl-0:
      description: |
        PORT pin configuration for TX, RX, RTS, CTS signals.
        We expect that the phandles will reference pinctrl nodes These
        nodes will have a nodelabel that matches the Infineon SoC Pinctrl
        defines and be of the form p<port>_<pin><peripheral inst>_<signal>.

        Examples
           use TX, RX
           pinctrl-0 = <&p5_1_scb5_uart_tx &p5_0_scb5_uart_rx>;

           use RX only
           pinctrl-0 = <&p5_0_scb5_uart_rx>;

           use TX, RX, RTS, CTS
           pinctrl-0 = <&p3_1_scb2_uart_tx &p3_0_scb2_uart_rx &p3_2_scb2_uart_rts &p3_3_scb2_uart_cts>;
      required: true

    pinctrl-names:
      required: true

    current-speed:
      type: int
      required: false
      description: Initial baud rate setting for UART
      default: 115200

    parity:
      required: false
      type: string
      description: |
        Configures the parity of the adapter. Enumeration id 0 for none, 1 for odd
        and 2 for even parity. Default to none if not specified.
      enum:
        - "none"
        - "odd"
        - "even"
      default: "none"

    stop_bits:
      required: false
      type: int
      description: |
        The number of stop bits, refer to uart_config_stop_bits
      default: 1

    data_bits:
      required: false
      type: int
      description: |
        The number of data bits:
        for 8 use 3 UART_CFG_DATA_BITS_8,
        for 9 use 4 UART_CFG_DATA_BITS_9,
        refer to uart_config_data_bits.
      default: 3
```

## samples/bluetooth/observer/sample.yaml
```yaml
sample:
  name: observer
tests:
  sample.bluetooth.observer:
    harness: bluetooth
    platform_allow: qemu_cortex_m3 qemu_x86 cy8cproto_062_4343w
    tags: bluetooth
```

## samples/bluetooth/scan_adv/sample.yaml
```yaml
sample:
  description: TBD
  name: TBD
tests:
  sample.bluetooth.scan_adv:
    harness: bluetooth
    platform_allow: qemu_cortex_m3 qemu_x86 cy8cproto_062_4343w
    tags: bluetooth
```

## soc/arm/infineon_cat1/psoc6/Kconfig.defconfig
```kconfig
# Infineon PSoC 6 MCU line

# Copyright (c) 2021 Cypress Semiconductor Corporation.
# SPDX-License-Identifier: Apache-2.0

if SOC_FAMILY_CAT1
source "soc/arm/infineon_cat1/psoc6/Kconfig.defconfig.soc.*"

config SOC_SERIES
	default "psoc6"

config SYS_CLOCK_HW_CYCLES_PER_SEC
	default 100000000

config ROM_START_OFFSET
    default 0x2000  if SOC_PSOC6_CM0P_SLEEP
    default 0x20000 if SOC_PSOC6_CM0P_BLE
    default 0x2000  if SOC_PSOC6_CM0P_CRYPTO
    default 0x10000 if SOC_PSOC6_CM0P_SECURE

endif # SOC_FAMILY_CAT1A
```

## soc/arm/infineon_cat1/psoc6/Kconfig.series
```kconfig
# Copyright (c) 2021 Cypress Semiconductor Corporation.
# SPDX-License-Identifier: Apache-2.0

# Cypress PSoC™ 6 MCU lines
config SOC_SERIES_PSOC60
    bool "Infineon PSoC™ 60 series MCU(Value Line)"
    select SOC_FAMILY_CAT1
    help
      Enable support for Infineon PSoC™ 60 MCU series

config SOC_SERIES_PSOC61
    bool "Infineon PSoC™ 61 series MCU (Programmable Line)"
    select SOC_FAMILY_CAT1
    help
      Enable support for Infineon PSoC™ 61 MCU series

config SOC_SERIES_PSOC62
    bool "Infineon PSoC™ 62 series MCU (Performance Line)"
    select SOC_FAMILY_CAT1
    help
      Enable support for Infineon PSoC™ 62 MCU series

config SOC_SERIES_PSOC63
    bool "Infineon PSoC™ 63 series MCU (Connectivity Line)"
    select SOC_FAMILY_CAT1
    help
      Enable support for Infineon PSoC™ 63 MCU series

config SOC_SERIES_PSOC64
    bool "Infineon PSoC™ 64 series MCU (Security Line)"
    select SOC_FAMILY_CAT1
    help
      Enable support for Infineon PSoC™ 64 MCU series
```

## soc/arm/infineon_cat1/psoc6/Kconfig.soc
```kconfig
# Copyright (c) 2021 Cypress Semiconductor Corporation.
# SPDX-License-Identifier: Apache-2.0

# Infineon PSoC6 die
config SOC_DIE_PSOC6
    bool
    select ARM
    select CPU_CORTEX_M4
    select SOC_FAMILY_CAT1A
    select HAS_INFINEON_CAT1_DRIVERS

# Infineon PSoC6_01 die
config SOC_DIE_PSOC6_01
    bool
    select SOC_DIE_PSOC6

# Infineon PSoC6_02 die
config SOC_DIE_PSOC6_02
    bool
    select SOC_DIE_PSOC6

# Infineon PSoC6_03 die
config SOC_DIE_PSOC6_03
    bool
    select SOC_DIE_PSOC6

# Infineon PSoC6_04 die
config SOC_DIE_PSOC6_04
    bool
    select SOC_DIE_PSOC6


# Infineon MCUs
choice
    prompt "MPN"
    optional
osource "soc/arm/infineon_cat1/psoc6/Kconfig.soc.psoc6_*"
endchoice

if SOC_FAMILY_CAT1A

## PSoC™ 6 Cortex M0+ prebuilt images
choice
    prompt "PSoC™ 6 Cortex M0+ prebuilt images"
    help
      Prebuilt application images are executed on the Cortex-M0+ core of the PSoC™ 6 dual - core MCU.
      The images are provided as C arrays ready to be compiled as part of the Cortex-M4 application.
      The Cortex-M0+ application code is placed to internal flash by the Cortex-M4 linker script.

config SOC_PSOC6_CM0P_SLEEP
    bool "DeepSleep"
    help
      DeepSleep prebuilt application image is executed on the Cortex-M0+ core of the PSoC™ 6 BLE
      dual-core MCU.The image is provided as C array ready to be compiled as part of the Cortex-M4
      application. The Cortex-M0+ application code is placed to internal flash by the Cortex-M4
      linker script.

config SOC_PSOC6_CM0P_BLE
    bool "BLESS Controller"
    depends on SOC_SERIES_PSOC63
    help
      Pre-compiled BLESS Controller image executed on the Cortex-M0+ core of the PSoC™ 6 dual-core MCU.
      The image is provided as C array ready to be compiled as part of the Cortex M4 application. 
      The Cortex-M0+ application code is placed to internal flash by the Cortex M4 linker script.
      This image is used only in BLE dual CPU mode.In this mode, the BLE functionality is split between
      CM0 + (controller) and CM4 (host). It uses IPC for communication between two CPU cores where both the
      controller and host run.

config SOC_PSOC6_CM0P_CRYPTO
    bool "Crypto server"
    help
      Crypto server prebuilt application image is executed on the Cortex-M0+ core of the PSoC™ 6
      dual-core MCU. The image is provided as C array ready to be compiled as part of the Cortex-M4
      application. The Cortex-M0+ application code is placed to internal flash by the Cortex-M4
      linker script.

config SOC_PSOC6_CM0P_SECURE
    bool "Secure"
    depends on SOC_SERIES_PSOC64
    help
      Secure prebuilt application image is required to be executed on the Cortex-M0+ core of the PSoC™ 64
      dual-core MCU. Users of PSoC™ 64 Secure Boot devices have multi image boot scheme. In this case the
      Bootloader assumes 2 images are present in system - CM0p and CM4 in MCUBoot compatible format.
      All applications developed for CM4 need to be combined with Secure CM0p prebuild image. 
      This is a requirement of Secure Boot system architecture.

endchoice

endif # SOC_FAMILY_CAT1A
```
